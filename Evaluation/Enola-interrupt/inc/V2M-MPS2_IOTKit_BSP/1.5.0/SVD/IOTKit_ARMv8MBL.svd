# IOTKit_ARMv8MBLL register map
Vendor: ARM Ltd.; Series: ARMv8-M Baseline; File version: 1.0
ARM 32-bit v8-M Baseline based device
CPU: ARMV8MBL r0p0, little endian, MPU, no FPU, 3 interrupt priority bits, 4 SAU regions
Registers are 32-bit, read-write, reset 0x0 unless marked. A register's access mark holds for its fields unless they carry their own. Offsets are from the block's base; lines under a group give offsets from that group; [hi:lo] are bit positions; {n}, {i} and the like mark numbered series; 'fields as' and 'values as' point back to an identical list; <NAME> marks a mode.

## Memory map
0x02656F10 UART2 size 0x14 — UART 2 (Non-Secure)
0x40000000 TIMER0 size 0x10 — Timer 0 (Non-Secure)
0x40001000 TIMER1 size 0x10 — Timer 1 (Non-Secure)
0x40002000 DUALTIMER size 0x3C
0x40008000 WATCHDOG size 0xC04 — Watchdog Timer
0x40080000 NSPC size 0xD0 — Non-Secure Privilege Control Block
0x40100000 GPIO0 size 0x3C — GPIO 0 (Non-Secure)
0x40101000 GPIO1 size 0x3C — GPIO 1 (Non-Secure)
0x40102000 GPIO2 size 0x3C — GPIO 2 (Non-Secure)
0x40103000 GPIO3 size 0x3C — GPIO 3 (Non-Secure)
0x40110000 DMA0 size 0x510 — DMA 0 (Non-Secure)
0x40111000 DMA1 size 0x510 — DMA 1 (Non-Secure)
0x40112000 DMA2 size 0x510 — DMA 2 (Non-Secure)
0x40113000 DMA3 size 0x510 — DMA 3 (Non-Secure)
0x40200000 UART0 size 0x14 — UART 0 (Non-Secure)
0x40201000 UART1 size 0x14 — UART 1 (Non-Secure)
0x40203000 UART3 size 0x14 — UART 3 (Non-Secure)
0x40204000 UART4 size 0x14 — UART 4 (Non-Secure)
0x40205000 SSP0 size 0x40 — SPI 0 (Non-Secure)
0x40206000 SSP1 size 0x40 — SPI 1 (Non-Secure)
0x40207000 I2C0 size 0xC — I2C 0 (Non-Secure)
0x40208000 I2C1 size 0xC — I2C 1 (Non-Secure)
0x40209000 SSP2 size 0x40 — SPI 2 (Non-Secure)
0x4020A000 SSP3 size 0x40 — SPI 3 (Non-Secure)
0x4020B000 SSP4 size 0x40 — SPI 4 (Non-Secure)
0x4020C000 I2C2 size 0xC — I2C 2 (Non-Secure)
0x4020D000 I2C3 size 0xC — I2C 3 (Non-Secure)
0x40300000 SCC size 0x1000 — Serial Communication Controller
0x40301000 I2S size 0x30C — simple audio I2S peripheral (Non-Secure)
0x40302000 FPGASYS size 0x50 — FPGA System Control I/O
0x50000000 TIMER0_Secure size 0x10
0x50001000 TIMER1_Secure size 0x10
0x50002000 DUALTIMER_Secure size 0x3C
0x50007000 DEBUG size 0x1000
0x50080000 SPC size 0xD4 — Secure Privilege Control Block
0x50100000 GPIO0_Secure size 0x3C
0x50101000 GPIO1_Secure size 0x3C
0x50102000 GPIO2_Secure size 0x3C
0x50103000 GPIO3_Secure size 0x3C
0x50110000 DMA0_SECURE size 0x510
0x50111000 DMA1_SECURE size 0x510
0x50112000 DMA2_SECURE size 0x510
0x50113000 DMA3_SECURE size 0x510
0x50200000 UART0_Secure size 0x14
0x50201000 UART1_Secure size 0x14
0x50202000 UART2_Secure size 0x14
0x50203000 UART3_Secure size 0x14
0x50204000 UART4_Secure size 0x14
0x50205000 SSP0_Secure size 0x40 — SPI 0 (Secure)
0x50206000 SSP1_Secure size 0x40 — SPI 1 (Secure)
0x50207000 I2C0_Secure size 0xC
0x50208000 I2C1_Secure size 0xC
0x50209000 SSP2_Secure size 0x40 — SPI 2 (Secure)
0x5020A000 SSP3_Secure size 0x40 — SPI 3 (Secure)
0x5020B000 SSP4_Secure size 0x40 — SPI 4 (Secure)
0x5020C000 I2C2_Secure size 0xC
0x5020D000 I2C3_Secure size 0xC
0x50300000 SCC_Secure size 0x1000 — Serial Communication Controller I/O (Secure)
0x50301000 I2S_Secure size 0x30C — simple audio I2S peripheral (Secure)
0x50302000 FPGASYS_Secure size 0x50 — FPGA System Control I/O (Secure)
0x58007000 MPC_SSRAM1 size 0x38 — Memory Protection Controller SSRAM1
0x58008000 MPC_SSRAM2 size 0x38 — Memory Protection Controller SSRAM2
0x58009000 MPC_SSRAM3 size 0x38 — Memory Protection Controller SSRAM3

## Interrupts
0 WATCHDOG — Watchdog interrupt
3 TIMER0 — Timer 0 interrupt
4 TIMER1 — Timer 1 interrupt
5 DUALTIMER — Dual Timer interrupt
32 UART0_RX (UART0) — UART 0 RX interrupt
33 UART0_TX (UART0) — UART 0 TX interrupt
34 UART1_RX (UART1) — UART 1 RX interrupt
35 UART1_TX (UART1) — UART 1 TX interrupt
36 UART2_RX (UART2) — UART 2 RX interrupt
37 UART2_TX (UART2) — UART 2 TX interrupt
38 UART3_RX (UART3) — UART 3 RX interrupt
39 UART3_TX (UART3) — UART 3 TX interrupt
40 UART4_RX (UART4) — UART 4 RX interrupt
41 UART4_TX (UART4) — UART 4 TX interrupt
42 UART0 — UART 0 combined interrupt
43 UART1 — UART 1 combined interrupt
44 UART2 — UART 2 combined interrupt
45 UART3 — UART 3 combined interrupt
46 UART4 — UART 4 combined interrupt
47 UART_OVF (UART0) — UART 0/1/2/3/4 overflow interrupt
49 I2S — I2S interrupt
51 SPI0 (SSP0) — SPI 0 interrupt
52 SPI1 (SSP1) — SPI 1 interrupt
53 SPI2 (SSP2) — SPI 2 interrupt
54 SPI3 (SSP3) — SPI 3 interrupt
55 SPI4 (SSP4) — SPI 4 interrupt
56 DMA0_ERROR (DMA0) — DMA 0 error interrupt
57 DMA0_TC (DMA0) — DMA 0 terminal count interrupt
58 DMA0 — DMA 0 combined interrupt
59 DMA1_ERROR (DMA1) — DMA 1 error interrupt
60 DMA1_TC (DMA1) — DMA 1 terminal count interrupt
61 DMA1 — DMA 1 combined interrupt
62 DMA2_ERROR (DMA2) — DMA 2 error interrupt
63 DMA2_TC (DMA2) — DMA 2 terminal count interrupt
64 DMA2 — DMA 2 combined interrupt
65 DMA3_ERROR (DMA3) — DMA 3 error interrupt
66 DMA3_TC (DMA3) — DMA 3 terminal count interrupt
67 DMA3 — DMA 3 combined interrupt
68 GPIO0 — GPIO 0 combined interrupt
69 GPIO1 — GPIO 1 combined interrupt
70 GPIO2 — GPIO 2 combined interrupt
71 GPIO3 — GPIO 3 combined interrupt
{n+72} GPIO0_{n} (GPIO0) (n=0..15) — GPIO 0 Pin {n} interrupt
{n+88} GPIO1_{n} (GPIO1) (n=0..15) — GPIO 1 Pin {n} interrupt
{n+104} GPIO2_{n} (GPIO2) (n=0..15) — GPIO 2 Pin {n} interrupt
120 GPIO3_0 (GPIO3) — GPIO 3 Pin 0 interrupt
121 GPIO3_1 (GPIO3) — GPIO 3 Pin 1 interrupt
122 GPIO3_2 (GPIO3) — GPIO 3 Pin 2 interrupt
123 GPIO3_3 (GPIO3) — GPIO 3 Pin 3 interrupt

## Licence text in the file
ARM Limited (ARM) is supplying this software for use with Cortex-M processor based microcontroller, but can be equally used for other suitable processor architectures. This file can be freely distributed. Modifications to this file shall be clearly marked. . THIS SOFTWARE IS PROVIDED "AS IS". NO WARRANTIES, WHETHER EXPRESS, IMPLIED. OR STATUTORY, INCLUDING, BUT NOT LIMITED TO, IMPLIED WARRANTIES OF. MERCHANTABILITY AND FITNESS FOR A PARTICULAR PURPOSE APPLY TO THIS SOFTWARE. ARM SHALL NOT, IN ANY CIRCUMSTANCES, BE LIABLE FOR SPECIAL, INCIDENTAL, OR. CONSEQUENTIAL DAMAGES, FOR ANY REASON WHATSOEVER.

## Notices in the file
Copyright (C) 2012-2017 ARM Limited. All rights reserved.
Purpose: System Viewer Description (SVD) Example (Schema Version 1.1)
This is a description of a none-existent and incomplete device
for demonstration purposes only.
Redistribution and use in source and binary forms, with or without
modification, are permitted provided that the following conditions are met:
- Redistributions of source code must retain the above copyright
notice, this list of conditions and the following disclaimer.
- Redistributions in binary form must reproduce the above copyright
notice, this list of conditions and the following disclaimer in the
documentation and/or other materials provided with the distribution.
- Neither the name of ARM nor the names of its contributors may be used
to endorse or promote products derived from this software without
specific prior written permission.
THIS SOFTWARE IS PROVIDED BY THE COPYRIGHT HOLDERS AND CONTRIBUTORS "AS IS"
AND ANY EXPRESS OR IMPLIED WARRANTIES, INCLUDING, BUT NOT LIMITED TO, THE
ARE DISCLAIMED. IN NO EVENT SHALL COPYRIGHT HOLDERS AND CONTRIBUTORS BE
LIABLE FOR ANY DIRECT, INDIRECT, INCIDENTAL, SPECIAL, EXEMPLARY, OR
CONSEQUENTIAL DAMAGES (INCLUDING, BUT NOT LIMITED TO, PROCUREMENT OF
SUBSTITUTE GOODS OR SERVICES; LOSS OF USE, DATA, OR PROFITS; OR BUSINESS
INTERRUPTION) HOWEVER CAUSED AND ON ANY THEORY OF LIABILITY, WHETHER IN
CONTRACT, STRICT LIABILITY, OR TORT (INCLUDING NEGLIGENCE OR OTHERWISE)
ARISING IN ANY WAY OUT OF THE USE OF THIS SOFTWARE, EVEN IF ADVISED OF THE
POSSIBILITY OF SUCH DAMAGE.
